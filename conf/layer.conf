## conf/layer.conf
```bitbake
# SPDX-License-Identifier: MIT
# Copyright (C) 2026 Embetrix Embedded Systems Solutions <ayoub.zaki@embetrix.com>

BBPATH .= ":${LAYERDIR}"
BBFILES += "${LAYERDIR}/recipes-*/*/*.bb ${LAYERDIR}/recipes-*/*/*.bbappend"

BBFILES_DYNAMIC += " \
    tpm-layer:${LAYERDIR}/dynamic-layers/tpm/recipes-*/*/*.bbappend \
    swupdate:${LAYERDIR}/dynamic-layers/swupdate/recipes-*/*/*.bb \
    swupdate:${LAYERDIR}/dynamic-layers/swupdate/recipes-*/*/*.bbappend \
    selinux:${LAYERDIR}/dynamic-layers/selinux/recipes-*/*/*.bb \
    selinux:${LAYERDIR}/dynamic-layers/selinux/recipes-*/*/*.bbappend \
"

BBFILE_COLLECTIONS += "imx-secure"
BBFILE_PATTERN_imx-secure = "^${LAYERDIR}/"
BBFILE_PRIORITY_imx-secure = "9"

# Keep the layer path for Git version lookup and optional integrations
IMX_SECURE_BASE := "${LAYERDIR}"

LAYERDEPENDS_imx-secure = " \
    core \
    openembedded-layer \
    meta-python \
    networking-layer \
    multimedia-layer \
    meta-arm \
    arm-toolchain \
    freescale-layer \
    avb \
    security \
    integrity \
"
LAYERSERIES_COMPAT_imx-secure = "wrynose"
```

## dynamic-layers/swupdate/conf/distro/include/imx-secure-swupdate.inc
```bitbake
# SPDX-License-Identifier: MIT
# Copyright (C) 2026 Embetrix Embedded Systems Solutions <ayoub.zaki@embetrix.com>

SWUPDATE_SIGNING = "CMS"
```

## dynamic-layers/swupdate/recipes-support/swupdate/files/defconfig
```kconfig
# SPDX-License-Identifier: MIT
# Copyright (C) 2026 Embetrix Embedded Systems Solutions <ayoub.zaki@embetrix.com>
CONFIG_SYSTEMD=y
CONFIG_DEFAULT_CONFIG_FILE="/etc/swupdate/swupdate.cfg"
# CONFIG_SCRIPTS is not set
CONFIG_HW_COMPATIBILITY=y
CONFIG_HW_COMPATIBILITY_FILE="/etc/hwrevision"
# CONFIG_BOOTLOADER_NONE is not set
CONFIG_UBOOT=y
CONFIG_UBOOT_FWENV="/etc/fw_env.config"
CONFIG_UBOOT_DEFAULTENV="/etc/u-boot-initial-env"
CONFIG_BOOTLOADER_DEFAULT_UBOOT=y
CONFIG_UPDATE_STATE_CHOICE_BOOTLOADER=y
CONFIG_UPDATE_STATE_BOOTLOADER="ustate"
# CONFIG_MTD is not set
CONFIG_LUA=y
CONFIG_LUAPKG="lua"
# CONFIG_DOWNLOAD is not set
# CONFIG_SURICATTA is not set
# CONFIG_WEBSERVER is not set
CONFIG_SSL_IMPL_OPENSSL=y
CONFIG_SWUPDATE_CRYPTO=y
CONFIG_HASH_VERIFY=y
CONFIG_SIGNED_IMAGES=y
# CONFIG_SIGALG_RAWRSA is not set
# CONFIG_SIGALG_RSAPSS is not set
CONFIG_SIGALG_CMS=y
CONFIG_PKCS11=y
CONFIG_ENCRYPTED_IMAGES=y
CONFIG_ENCRYPTED_IMAGES_HARDEN_LOGGING=y
CONFIG_GUNZIP=y
CONFIG_LIBCONFIG=y
CONFIG_BOOTLOADERHANDLER=y
CONFIG_RAW=y
# CONFIG_SHELLSCRIPTHANDLER is not set
```
