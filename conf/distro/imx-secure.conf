## conf/distro/imx-secure.conf
```bitbake
# SPDX-License-Identifier: MIT
# Copyright (C) 2026 Embetrix Embedded Systems Solutions <ayoub.zaki@embetrix.com>

# Use OE-Core defaults from defaultsetup.conf
DISTRO = "imx-secure"
DISTRO_NAME = "i.MX Secure"
DISTRO_VERSION = "0.1"

DISTRO_FEATURES += "polkit ima integrity security"

# Development and production profiles
IMX_SECURITY_PROFILE ??= "dev"
INHERIT += "imx-security-profile"

# Allow password-free logins in development images
EXTRA_IMAGE_FEATURES:append = " ${@bb.utils.contains('IMX_SECURITY_PROFILE', 'dev', \
    'allow-empty-password allow-root-login empty-root-password', '', d)}"

# Remove development login features from production images
IMAGE_FEATURES:remove = "${@bb.utils.contains('IMX_SECURITY_PROFILE', 'prod', \
    'allow-empty-password allow-root-login empty-root-password', '', d)}"

# Shared i.MX machine settings
require conf/machine/include/imx-secure.inc

# Root filesystem signing
INHERIT += "ima-evm-rootfs"
IMAGE_CLASSES += "avb-verity"
```

## conf/distro/include/imx-secure-distro.inc
```bitbake
# SPDX-License-Identifier: MIT
# Copyright (C) 2026 Embetrix Embedded Systems Solutions <ayoub.zaki@embetrix.com>

# Use OE-Core defaults from defaultsetup.conf
DISTRO = "imx-secure"
DISTRO_NAME = "i.MX Secure"
DISTRO_VERSION = "0.1"

DISTRO_FEATURES += "polkit ima integrity security"

# Development and production profiles
IMX_SECURITY_PROFILE ??= "dev"
INHERIT += "imx-security-profile"

# Include the security profile in image filenames
IMAGE_NAME:append = "-${IMX_SECURITY_PROFILE}"

# Allow password-free logins in development images
EXTRA_IMAGE_FEATURES:append = " ${@bb.utils.contains('IMX_SECURITY_PROFILE', 'dev', \
    'allow-empty-password allow-root-login empty-root-password', '', d)}"

# Remove development login features from production images
IMAGE_FEATURES:remove = "${@bb.utils.contains('IMX_SECURITY_PROFILE', 'prod', \
    'allow-empty-password allow-root-login empty-root-password', '', d)}"

# Shared i.MX machine settings
require conf/machine/include/imx-secure.inc

# Root filesystem signing
INHERIT += "ima-evm-rootfs"
IMAGE_CLASSES += "avb-verity"

# CVE checks conditional on security profile
IMAGE_CLASSES += "${@bb.utils.contains('IMX_SECURITY_PROFILE', 'prod', 'sbom-cve-check', '', d)}"
require conf/distro/include/cve-extra-exclusions.inc

# Set persistent Logs
FILESYSTEM_PERMS_TABLES:remove = "files/fs-perms-volatile-log.txt"
```

## conf/layer.conf
```bitbake
# SPDX-License-Identifier: MIT
# Copyright (C) 2026 Embetrix Embedded Systems Solutions <ayoub.zaki@embetrix.com>

BBPATH .= ":${LAYERDIR}"
BBFILES += "${LAYERDIR}/recipes-*/*/*.bb ${LAYERDIR}/recipes-*/*/*.bbappend"

BBFILE_COLLECTIONS += "imx-secure"
BBFILE_PATTERN_imx-secure = "^${LAYERDIR}/"
BBFILE_PRIORITY_imx-secure = "9"

LAYERDEPENDS_imx-secure = " \
    core \
    openembedded-layer \
    meta-python \
    perl-layer \
    networking-layer \
    multimedia-layer \
    meta-arm \
    arm-toolchain \
    freescale-layer \
    fsl-bsp-release \
    avb \
    security \
    integrity \
"
LAYERSERIES_COMPAT_imx-secure = "wrynose"
```

## conf/machine/include/imx-secure.inc
```bitbake
# SPDX-License-Identifier: MIT
# Copyright (C) 2026 Embetrix Embedded Systems Solutions <ayoub.zaki@embetrix.com>

# Shared signing key checks
INHERIT += "imx-signing-keys"

# Default PKCS#11 library
OPENSSL_PKCS11_DEFAULT_PROVIDER ??= "optee"

# FIT signing
UBOOT_SIGN_ENABLE ?= "${@d.getVar('IMX_SIGN_ENABLE') or '0'}"
UBOOT_SIGN_KEYDIR ?= ""
UBOOT_SIGN_KEYNAME ?= "fit"
FIT_SIGN_ALG ?= "rsa2048"
FIT_SIGN_INDIVIDUAL = "0"

# Provide kernel artifacts for FIT generation alongside Image
KERNEL_CLASSES:append = " kernel-fit-extra-artifacts"

# i.MX91 and i.MX95 entry points are missing from meta-freescale's imx-base.inc
UBOOT_ENTRYPOINT:mx91-generic-bsp ?= "0x80400000"
UBOOT_ENTRYPOINT:mx95-generic-bsp ?= "0x90400000"

# Initramfs Bundle
INITRAMFS_IMAGE        ?= "imx-secure-initramfs-image"
INITRAMFS_IMAGE_NAME   ?= "imx-secure-initramfs-image-${MACHINE}.rootfs"
INITRAMFS_IMAGE_BUNDLE  = "1"

# Boot image and disk layout
IMX_BOOTLOADER ?= "${@bb.utils.contains('IMX_SIGN_ENABLE', '1', \
    'imx-boot.tagged.sign', 'imx-boot.tagged', d)}"
WKS_FILE = "imx-boot-secure-bootpart.wks.in"

# Keep BSP additions out of the active boot partition
IMAGE_BOOT_FILES = "fitImage"
WICVARS:append = " IMAGE_BOOT_FILES_label-boot_a"
do_image_wic[depends] += "linux-yocto-fitimage:do_deploy"

# Root filesystem and output formats
ROOTFS_TYPE ?= "erofs"
AVB_ROOT_HASH_SIGN ?= "1"
IMAGE_FSTYPES += "wic.gz wic.bmap ${ROOTFS_TYPE}.avbverity.gz"

# Partition sizes
BOOT_PART_SZ ?= "512M"
ROOT_PART_SZ ?= "1024M"
SECDATA_PART_SZ ?= "512M"
DATA_PART_SZ ?= "4096M"
```
